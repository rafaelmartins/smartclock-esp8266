## main/Kconfig.projbuild
```kconfig
menu "smartclock-esp8622"

menu "Wifi"

config SMARTCLOCK_ESP8266_WIFI_SSID
    string "Wifi SSID"

config SMARTCLOCK_ESP8266_WIFI_PASSWORD
    string "Wifi Password"

endmenu

menu "SNTP"

config SMARTCLOCK_ESP8266_SNTP_UPDATE_DELAY
    int "SNTP Update Delay"
    default 3600000

config SMARTCLOCK_ESP8266_TIMEZONE
    string "Timezone"
    default "CET-1CEST,M3.5.0,M10.5.0/3"

endmenu

menu "GPIO configuration"

config SMARTCLOCK_ESP8266_GPIO_BUTTON
    int "Input: Button"
    default 2
    range 0 16

config SMARTCLOCK_ESP8266_GPIO_I2C_SDA
    int "Output: I2C SDA"
    default 0
    range 0 16

config SMARTCLOCK_ESP8266_GPIO_I2C_SCL
    int "Output: I2C SCL"
    default 4
    range 0 16

endmenu

endmenu
```
